## esp32/main/Kconfig.projbuild
```kconfig
menu "ensemble playback node"

    choice ENSEMBLE_BOARD
        prompt "Target board"
        default ENSEMBLE_BOARD_ESP32S3
        help
            Selects the default pin map and capabilities in boards/. Every value
            is overridable at provisioning time over USB and stored in NVS, so one
            image still fits many wirings — this only sets the power-on defaults.

        config ENSEMBLE_BOARD_ESP32S3
            bool "ESP32-S3-WROOM-1 / DevKitC-1"
        config ENSEMBLE_BOARD_ESP32S3_SUPERMINI
            bool "ESP32-S3 Super Mini (22.5x18mm, USB-C, WS2812 on GPIO48)"
        config ENSEMBLE_BOARD_ESP32S3_ZERO
            bool "Waveshare ESP32-S3-Zero (23.5x18mm, USB-C, WS2812 on GPIO21)"
        config ENSEMBLE_BOARD_ESP32S3_AMPED_PLUS
            bool "Sonocotta Amped-ESP32-S3-Plus (PCM5122 DAC + TPA3110 amp, N16R8)"
        config ENSEMBLE_BOARD_ESP32S3_HIFI
            bool "Sonocotta HiFi-ESP32-S3 (PCM5100A DAC, line-out)"
        config ENSEMBLE_BOARD_ESP32S3_AMPED
            bool "Sonocotta Amped-ESP32-S3 (PCM5100A DAC + TPA3110 amp)"
        config ENSEMBLE_BOARD_ESP32S3_LOUD
            bool "Sonocotta Loud-ESP32-S3 (dual MAX98357A DAC+amp)"
        config ENSEMBLE_BOARD_ESP32S3_HIFI_PLUS
            bool "Sonocotta HiFi-ESP32-Plus (PCM5122 DSP DAC, line-out)"
        config ENSEMBLE_BOARD_ESP32S3_LOUDER
            bool "Sonocotta Louder-ESP32-S3 / Mini (TAS5805M DSP amp)"
        config ENSEMBLE_BOARD_ESP32S3_LOUDER_PLUS
            bool "Sonocotta Louder-ESP32-Plus / Pro (TAS5825M DSP amp)"
        config ENSEMBLE_BOARD_ESP32S3_LOUD_PLUS
            bool "Sonocotta Loud-ESP32-Plus (MA12070P DSP amp)"
        config ENSEMBLE_BOARD_GENERIC
            bool "Generic (compile-time pins, no board profile)"
    endchoice

    config ENSEMBLE_CONTROL_PORT
        int "Default CONTROL_PORT (master -> playback commands)"
        default 9300
        help
            UDP port advertised over mDNS where the master sends ATTACH / DETACH /
            SETVOL etc. (PLAYER §4). Overridable in NVS.

    config ENSEMBLE_STA_CONNECT_TIMEOUT_MS
        int "Wi-Fi connect timeout before falling into the captive portal (ms)"
        default 30000
        help
            On boot with stored credentials, how long to wait for an IP before
            giving up and opening the Wi-Fi captive portal (provision.c). Covers a
            transient outage of the stored AP.

    config ENSEMBLE_PORTAL_TIMEOUT_MS
        int "Captive-portal lifetime before going inert (ms)"
        default 600000
        help
            How long the open AP + captive portal stays up before it tears itself
            down and the node goes inert (no reboot, no retry) until power-cycled.
            The USB console stays available the whole time. Default 10 minutes.

endmenu
```

## esp32/sdkconfig.defaults
```kconfig
# Common defaults for every board. Per-board files (sdkconfig.defaults.<board>)
# layer the console/USB choice and flash size on top (see CMakeLists.txt).

# --- Partition table (dual-OTA, see partitions.csv) ---
CONFIG_PARTITION_TABLE_CUSTOM=y
CONFIG_PARTITION_TABLE_CUSTOM_FILENAME="partitions.csv"

# --- Performance: the audio + servo loops want -O2 ---
CONFIG_COMPILER_OPTIMIZATION_PERF=y

# --- FreeRTOS: 1 kHz tick so vTaskDelay/playout sleeps have ms granularity ---
CONFIG_FREERTOS_HZ=1000

# --- Wi-Fi: keep the driver's buffers modest so it fits alongside the jitter
#     buffer + opus decoder on the 320 KB S2 (bumping these OOMs the Wi-Fi init:
#     "malloc buffer fail / Expected to init N rx buffer, actual is 1"). ---
CONFIG_ESP_WIFI_STATIC_RX_BUFFER_NUM=4
CONFIG_ESP_WIFI_DYNAMIC_RX_BUFFER_NUM=16
CONFIG_ESP_WIFI_DYNAMIC_TX_BUFFER_NUM=16

# --- lwIP: bigger UDP/socket budget for audio + clock + control sockets ---
CONFIG_LWIP_MAX_SOCKETS=10
CONFIG_LWIP_SO_RCVBUF=y

# --- mDNS managed component knobs ---
CONFIG_MDNS_MAX_SERVICES=5
CONFIG_MDNS_TASK_STACK_SIZE=3072

# --- Main task stack: app_main does NVS + netif + task spawns ---
CONFIG_ESP_MAIN_TASK_STACK_SIZE=6144

# --- HTTP server (captive portal, provision.c): the 512 B default header limit
#     rejects modern phones/browsers ("431 request header fields too long"), whose
#     captive-portal probes send a big pile of headers. Give it room. ---
CONFIG_HTTPD_MAX_REQ_HDR_LEN=2048
```

## esp32/sdkconfig.defaults.esp32s3
```kconfig
# ESP32-S3-WROOM-1 / DevKitC-1. Native USB-Serial-JTAG is the console the web
# flasher's Improv + JSON config talk over (no external UART bridge needed).
CONFIG_IDF_TARGET="esp32s3"
CONFIG_ESPTOOLPY_FLASHSIZE_4MB=y

# Console + stdio over the built-in USB-Serial-JTAG CDC port.
CONFIG_ESP_CONSOLE_USB_SERIAL_JTAG=y
CONFIG_ESP_CONSOLE_SECONDARY_NONE=y

# Board selection (boards/board.h + default pin map).
CONFIG_ENSEMBLE_BOARD_ESP32S3=y
```

## esp32/sdkconfig.defaults.esp32s3-amped-plus
```kconfig
# Sonocotta Amped-ESP32-S3-Plus (rev C) — ESP32-S3-WROOM-1 + 8 MB OCTAL PSRAM,
# PCM5122 DAC + TPA3110 amp on one board. Same S3 native USB-Serial-JTAG console
# as the other S3 boards (no external UART bridge) — what the web flasher's Improv
# + JSON config talk over.
CONFIG_IDF_TARGET="esp32s3"
# 8 MB flash: the rev-C schematic marks the module "N16R8" (16 MB) but the shipping
# board reports 8 MB (`detected size 8192k`) and Sonocotta's own ESPHome uses 8 MB.
# 16 MB here boot-loops with "Detected size smaller than the binary image header".
CONFIG_ESPTOOLPY_FLASHSIZE_8MB=y

# Octal PSRAM shares the SPI bus with the flash, so keep the flash in DIO mode
# (matches Sonocotta's own ESPHome build).
CONFIG_ESPTOOLPY_FLASHMODE_DIO=y

# Console + stdio over the built-in USB-Serial-JTAG CDC port.
CONFIG_ESP_CONSOLE_USB_SERIAL_JTAG=y
CONFIG_ESP_CONSOLE_SECONDARY_NONE=y

# Board selection (boards/board.h + default pin map).
CONFIG_ENSEMBLE_BOARD_ESP32S3_AMPED_PLUS=y

# PSRAM: 8 MB embedded OCTAL (N16R8) — players are PSRAM-only (docs/developer/
# esp32.md §3.1). OCT mode, auto-size, 80 MHz. This board always has PSRAM, so no
# IGNORE_NOTFOUND fallback (unlike the bare Super Mini / Zero bench builds).
CONFIG_SPIRAM=y
CONFIG_SPIRAM_MODE_OCT=y
CONFIG_SPIRAM_TYPE_AUTO=y
CONFIG_SPIRAM_SPEED_80M=y
```

## esp32/sdkconfig.defaults.esp32s3-hifi-plus
```kconfig
# Sonocotta HiFi-ESP32-Plus (S3) — PCM5122 DSP DAC, line-out.
# ESP32-S3-WROOM-1 audio-dock carrier. Same native USB-Serial-JTAG console as the
# other S3 boards.
CONFIG_IDF_TARGET="esp32s3"

# 8 MB flash + 8 MB OCTAL PSRAM (confirmed from Sonocotta's ESPHome: flash_size 8MB,
# psram mode octal). Baked into the image — not re-provisionable over USB.
CONFIG_ESPTOOLPY_FLASHSIZE_8MB=y
CONFIG_ESPTOOLPY_FLASHMODE_DIO=y

# Console + stdio over the built-in USB-Serial-JTAG CDC port.
CONFIG_ESP_CONSOLE_USB_SERIAL_JTAG=y
CONFIG_ESP_CONSOLE_SECONDARY_NONE=y

# Board selection (boards/board.h + default pin map).
CONFIG_ENSEMBLE_BOARD_ESP32S3_HIFI_PLUS=y

# PSRAM: octal, auto-size, 80 MHz (players are PSRAM-only — docs/developer/esp32.md §3.1).
CONFIG_SPIRAM=y
CONFIG_SPIRAM_MODE_OCT=y
CONFIG_SPIRAM_TYPE_AUTO=y
CONFIG_SPIRAM_SPEED_80M=y
```

## esp32/sdkconfig.defaults.esp32s3-loud
```kconfig
# Sonocotta Loud-ESP32-S3 — ESP32-S3-WROOM-1 audio-dock carrier, dual MAX98357A
# I2S DAC+amp. Same native USB-Serial-JTAG console as the other S3 boards.
CONFIG_IDF_TARGET="esp32s3"

# 8 MB flash + 8 MB OCTAL PSRAM, matching the Amped-ESP32-S3-Plus (same audio-dock
# module family). UNVERIFIED on this specific board — if it boot-loops with a flash
# size / PSRAM mismatch, adjust FLASHSIZE / SPIRAM_MODE here (these are baked into
# the image and can't be re-provisioned over USB).
CONFIG_ESPTOOLPY_FLASHSIZE_8MB=y
CONFIG_ESPTOOLPY_FLASHMODE_DIO=y

# Console + stdio over the built-in USB-Serial-JTAG CDC port.
CONFIG_ESP_CONSOLE_USB_SERIAL_JTAG=y
CONFIG_ESP_CONSOLE_SECONDARY_NONE=y

# Board selection (boards/board.h + default pin map).
CONFIG_ENSEMBLE_BOARD_ESP32S3_LOUD=y

# PSRAM: octal, auto-size, 80 MHz (players are PSRAM-only — docs/developer/esp32.md §3.1).
CONFIG_SPIRAM=y
CONFIG_SPIRAM_MODE_OCT=y
CONFIG_SPIRAM_TYPE_AUTO=y
CONFIG_SPIRAM_SPEED_80M=y
```

## esp32/sdkconfig.defaults.esp32s3-supermini
```kconfig
# ESP32-S3 Super Mini (22.5x18mm USB-C). Same S3 silicon as the DevKitC, so the
# console is the built-in USB-Serial-JTAG CDC (no external UART bridge) — exactly
# what the web flasher's Improv + JSON config talk over.
CONFIG_IDF_TARGET="esp32s3"
CONFIG_ESPTOOLPY_FLASHSIZE_4MB=y

# Console + stdio over the built-in USB-Serial-JTAG CDC port.
CONFIG_ESP_CONSOLE_USB_SERIAL_JTAG=y
CONFIG_ESP_CONSOLE_SECONDARY_NONE=y

# Board selection (boards/board.h + default pin map).
CONFIG_ONDAIRE_BOARD_ESP32S3_SUPERMINI=y

# PSRAM: the player target is the ESP32-S3FH4R2 variant (2 MB embedded quad
# PSRAM) — see docs/developer/esp32.md §3.1 (players are PSRAM-only). QUAD mode,
# auto-size. IGNORE_NOTFOUND lets the bare no-PSRAM Super Mini still boot as a
# bench build instead of aborting in the bootloader.
CONFIG_SPIRAM=y
CONFIG_SPIRAM_MODE_QUAD=y
CONFIG_SPIRAM_TYPE_AUTO=y
CONFIG_SPIRAM_SPEED_80M=y
CONFIG_SPIRAM_IGNORE_NOTFOUND=y
```

## esp32/sdkconfig.defaults.esp32s3-zero
```kconfig
# Waveshare ESP32-S3-Zero (23.5x18mm USB-C). Same S3FH4R2 silicon as the Super
# Mini, so the console is the built-in USB-Serial-JTAG CDC (no external UART
# bridge) — exactly what the web flasher's Improv + JSON config talk over. The
# only board difference is the WS2812 status LED (GPIO21 vs GPIO48).
CONFIG_IDF_TARGET="esp32s3"
CONFIG_ESPTOOLPY_FLASHSIZE_4MB=y

# Console + stdio over the built-in USB-Serial-JTAG CDC port.
CONFIG_ESP_CONSOLE_USB_SERIAL_JTAG=y
CONFIG_ESP_CONSOLE_SECONDARY_NONE=y

# Board selection (boards/board.h + default pin map).
CONFIG_ONDAIRE_BOARD_ESP32S3_ZERO=y

# PSRAM: the S3-Zero is the ESP32-S3FH4R2 variant (2 MB embedded quad PSRAM) —
# see docs/developer/esp32.md §3.1 (players are PSRAM-only). QUAD mode, auto-size.
# IGNORE_NOTFOUND keeps a bare no-PSRAM unit booting as a bench build rather than
# aborting in the bootloader.
CONFIG_SPIRAM=y
CONFIG_SPIRAM_MODE_QUAD=y
CONFIG_SPIRAM_TYPE_AUTO=y
CONFIG_SPIRAM_SPEED_80M=y
CONFIG_SPIRAM_IGNORE_NOTFOUND=y
```

## esp32/tools/dac-tone/sdkconfig.defaults
```kconfig
# Console + stdio over the Super Mini's built-in USB-Serial-JTAG (same as the
# real firmware), so `idf.py monitor` over /dev/ttyACM0 shows the log.
CONFIG_ESP_CONSOLE_USB_SERIAL_JTAG=y
CONFIG_ESP_CONSOLE_SECONDARY_NONE=y
CONFIG_ESPTOOLPY_FLASHSIZE_4MB=y
```
